ENTRY(_start)

PHDRS
{
    text     PT_LOAD FLAGS(5); /* Read + Execute */
    rodata   PT_LOAD FLAGS(4); /* Read only */
    data     PT_LOAD FLAGS(6); /* Read + Write */
}

SECTIONS
{
    /* basic virtual address for the kernel */
    . = 0xffffffff80000000;

    .text : {
        *(.text .text.*)
    } :text

    /* Aligning next section (4 KB) */
    . = ALIGN(4096);

    /* The section of constants and unchangeable data (strings, global const) */
    .rodata : {
        *(.rodata .rodata.*)
    } :rodata

    . = ALIGN(4096);

    /* The compiler places requests to the loader here */
    .limine_requests : {
        KEEP(*(.limine_requests_start))
        KEEP(*(.limine_requests))
        KEEP(*(.limine_requests_end))
    } :data

    . = ALIGN(4096);

    /*  The section of uninitialized global variables */
    .data : {
        *(.data .data.*)
    } :data

    /* The section of uninitialized data */
    .bss : {
        *(.bss .bss.*)
        *(COMMON)
    } :data

    /* Pruning uneccesary sections generated by modern compilers (e.g. gcc) */
    /DISCARD/ : {
        *(.eh_frame)
        *(.note .note.*)
    }
}
